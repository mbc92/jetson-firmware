## jetson-nano-build/conf/bblayers.conf
```bitbake
# POKY_BBLAYERS_CONF_VERSION is increased each time build/conf/bblayers.conf
# changes incompatibly
POKY_BBLAYERS_CONF_VERSION = "2"

BBPATH = "${TOPDIR}"
BBFILES ?= ""

BBLAYERS ?= " \
  /workdir/poky/meta \
  /workdir/poky/meta-poky \
  /workdir/poky/meta-yocto-bsp \
  /workdir/meta-tegra \
  /workdir/meta-jetson-custom \
  /workdir/meta-openembedded/meta-oe \
  /workdir/meta-openembedded/meta-python \
  /workdir/meta-openembedded/meta-networking \
  /workdir/meta-ros/meta-ros-common \
  /workdir/meta-ros/meta-ros2 \
  /workdir/meta-ros/meta-ros2-humble \
  "
```

## meta-jetson-custom/conf/distro/jetson-nano-compute.conf
```bitbake
# mydistro.conf

DISTRO_NAME = "jetson-nano-compute"

VIRTUAL-RUNTIME_init_manager = "systemd"

PREFERRED_VERSION_libglvnd = "1.4.0"

DISTRO_FEATURES:append = " systemd networkmanager wifi opengl"
```

## meta-jetson-custom/conf/layer.conf
```bitbake
# We have a conf and classes directory, add to BBPATH
BBPATH .= ":${LAYERDIR}"

# We have recipes-* directories, add to BBFILES
BBFILES += "${LAYERDIR}/recipes-*/*/*.bb \
            ${LAYERDIR}/recipes-*/*/*.bbappend"

BBFILE_COLLECTIONS += "meta-jetson-custom"
BBFILE_PATTERN_meta-jetson-custom = "^${LAYERDIR}/"
BBFILE_PRIORITY_meta-jetson-custom = "6"

LAYERDEPENDS_meta-jetson-custom = "core"
LAYERSERIES_COMPAT_meta-jetson-custom = "kirkstone"
```
