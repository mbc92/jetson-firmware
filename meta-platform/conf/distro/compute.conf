## meta-platform/conf/distro/compute.conf
```bitbake
DISTRO_NAME = "compute"

VIRTUAL-RUNTIME_init_manager = "systemd"

PREFERRED_VERSION_libglvnd = "1.4.0"

VIRTUAL-RUNTIME_wpa-supplicant = ""

DISTRO_FEATURES:append = " systemd networkmanager wifi opengl"
```

## meta-platform/conf/layer.conf
```bitbake
BBPATH:prepend := "${LAYERDIR}:"

BBFILES += "${LAYERDIR}/recipes-*/*/*.bb \
            ${LAYERDIR}/recipes-*/*/*.bbappend"

BBFILE_COLLECTIONS += "meta-platform"
BBFILE_PATTERN_meta-platform = "^${LAYERDIR}/"
BBFILE_PRIORITY_meta-platform = "6"

LAYERDEPENDS_meta-platform = "core"
LAYERSERIES_COMPAT_meta-platform = "kirkstone"
```

## meta-tegra-bsp/conf/layer.conf
```bitbake
BBPATH:prepend := "${LAYERDIR}:"

BBFILES += "${LAYERDIR}/recipes-*/*/*.bb \
            ${LAYERDIR}/recipes-*/*/*.bbappend"

BBFILE_COLLECTIONS += "meta-tegra-bsp"
BBFILE_PATTERN_meta-tegra-bsp = "^${LAYERDIR}/"
BBFILE_PRIORITY_meta-tegra-bsp = "6"

LAYERDEPENDS_meta-tegra-bsp = "core"
LAYERSERIES_COMPAT_meta-tegra-bsp = "kirkstone"
```
